## components/actuator_controller/Kconfig
```kconfig
menu "Actuator Controller"

    comment "Plain LEDs of light_1 and light_2 (-1: none, the light stays simulated)."
    comment "Avoid strapping (0, 3, 45, 46), flash/PSRAM (26-37), USB (19, 20), UART pins."

    config ACTUATOR_LIGHT_1_GPIO
        int "GPIO of light_1"
        range -1 48
        default 6

    config ACTUATOR_LIGHT_2_GPIO
        int "GPIO of light_2"
        range -1 48
        default 7

    config ACTUATOR_LIGHT_PULL_UP
        bool "Enable the internal pull-up on the LED GPIOs"
        default y
        help
            Holds the pads at a defined level while they are not driven (e.g. no LED wired yet).
            While driven, a push-pull output is never floating, so this only costs ~70 uA at low.

    config ACTUATOR_LIGHT_ACTIVE_LOW
        bool "The LEDs light with a low level (LED wired from 3.3 V to the GPIO)"
        default n

    comment "Relay modules: relay_1, relay_2 and the two directions of curtain_1 (-1: simulated)."

    config ACTUATOR_RELAY_1_GPIO
        int "GPIO of relay_1"
        range -1 48
        default -1

    config ACTUATOR_RELAY_2_GPIO
        int "GPIO of relay_2"
        range -1 48
        default -1

    config ACTUATOR_CURTAIN_UP_GPIO
        int "GPIO of the relay that raises curtain_1"
        range -1 48
        default 18
        help
            curtain_1 stays simulated unless both its GPIOs are set.

    config ACTUATOR_CURTAIN_DOWN_GPIO
        int "GPIO of the relay that lowers curtain_1"
        range -1 48
        default 21

    config ACTUATOR_RELAY_ACTIVE_LOW
        bool "The relays switch on with a low level"
        default y
        help
            Typical relay modules trigger at 0 V. The internal pull-up then holds them off while
            the GPIO is not driven (boot, reset).

    config ACTUATOR_CURTAIN_REVERSE_DELAY_MS
        int "Pause between stopping one direction and starting the other (ms)"
        range 0 5000
        default 500
        help
            Lets the motor stop before it is reversed, and the two relays are never on together.

endmenu
```

## components/connectivity_provider/Kconfig
```kconfig
menu "Connectivity Provider"

    config WIFI_SSID
        string "Wi-Fi SSID"
        default "myssid"

    config WIFI_PASSWORD
        string "Wi-Fi password"
        default "mypassword"

    config WIFI_COUNTRY_CODE
        string "Wi-Fi country code"
        default "PT"
        help
            ISO country code that sets the allowed channels. The ESP-IDF default
            "01" (world safe mode) does not actively scan channels 12-13, which
            routers and phone hotspots in Europe may use.

endmenu
```

## components/firebase_auth/Kconfig
```kconfig
menu "Firebase Auth"

    config FIREBASE_API_KEY
        string "Web API key"
        default ""
        help
            "apiKey" from the Firebase web app config (Project settings > General).
            Used to call the Firebase Auth REST API.

    config FIREBASE_USER_EMAIL
        string "Device user email"
        default ""
        help
            Email/password user the device signs in as. Leave empty to send
            requests without auth (only works with open database rules).

    config FIREBASE_USER_PASSWORD
        string "Device user password"
        default ""
        help
            Stored in the local sdkconfig and in the firmware image in plain text.
            Keep sdkconfig out of version control.

endmenu
```

## components/firebase_paths/Kconfig
```kconfig
menu "Firebase Paths"

    config DEVICE_ID
        string "Device ID"
        default "device-01"
        help
            Identifies this device under devices/<DEVICE_ID> and readings/<DEVICE_ID>.
            Must be a valid Firebase key: no ".", "$", "#", "[", "]" or "/".

endmenu
```

## components/firebase_rtdb/Kconfig
```kconfig
menu "Firebase Realtime Database"

    config FIREBASE_DB_URL
        string "Realtime Database URL"
        default "https://<project-id>-default-rtdb.firebaseio.com"
        help
            Base URL of the Realtime Database, without trailing slash.
            Authentication is configured in the "Firebase Auth" menu.

endmenu
```

## components/rgb_led/Kconfig
```kconfig
menu "RGB LED"

    config RGB_LED_GPIO
        int "GPIO of the addressable RGB LED (WS2812)"
        range 0 48
        default 48
        help
            ESP32-S3-DevKitC-1 v1.0 (and most N16R8 clones) wire the on-board RGB LED to GPIO48;
            v1.1 moved it to GPIO38. Try 38 if the LED stays dark.

endmenu
```

## components/sensor_provider/Kconfig
```kconfig
menu "Sensor Provider"

    config MQ135_GPIO
        int "GPIO of the MQ-135 output divider (gas_1; -1: simulated)"
        range -1 48
        default 8
        help
            ADC1 pin (GPIO1-10 on the ESP32-S3). The module is fed from 5 V and its analog
            output (AO) can reach 5 V: never connect it straight to the pin, use the divider below
            (and 100 nF from the pin to GND).

    config MQ135_DIVIDER_TOP_OHMS
        int "Divider resistor from AO to the GPIO (ohms)"
        range 1000 100000
        default 10000

    config MQ135_DIVIDER_BOTTOM_OHMS
        int "Divider resistor from the GPIO to GND (ohms)"
        range 1000 100000
        default 20000
        help
            With 10 k / 20 k the pin sees 2/3 of AO, up to 3.3 V at 5 V; the ADC saturates a bit
            earlier, which only happens with a gas level far above the sensor's range.

    config MQ135_LOAD_RESISTOR_OHMS
        int "Load resistor RL of the module (ohms)"
        range 100 1000000
        default 10000
        help
            Printed next to the SMD resistor of the module near the sensor: 102 = 1 kOhm,
            103 = 10 kOhm. Some modules have a trimmer instead; measure it.

    config MQ135_R0_OHMS
        int "R0: sensor resistance in clean air (ohms)"
        range 1000 10000000
        default 76630
        help
            Calibrate it: after at least 24 h of preheating, leave the sensor in fresh air (about
            400 ppm CO2) and set R0 to the "gas_1: Rs" value of the sensor_provider debug log (esp_log_level_set). The
            default is only a typical value.

    config LM35_GPIO
        int "GPIO of the LM35 output (temperature_2; -1: simulated)"
        range -1 48
        default 5
        help
            ADC1 pin (GPIO1-10 on the ESP32-S3): ADC2 cannot be read while Wi-Fi is active.
            Power the LM35 from 5 V (it needs at least 4 V): its output stays below 1.5 V
            up to 150 degC, safe for the ADC. 10 mV per degree Celsius.

    config LDR_GPIO
        int "GPIO of the first LDR divider (luminosity_1; -1: simulated)"
        range -1 48
        default 4
        help
            ADC1 pin (GPIO1-10 on the ESP32-S3): ADC2 cannot be read while Wi-Fi is active.

    config LDR_2_GPIO
        int "GPIO of the second LDR divider (luminosity_2; -1: simulated)"
        range -1 48
        default -1
        help
            Same divider values as the first LDR. ADC1 pin (GPIO1-10 on the ESP32-S3).

    config LDR_TO_SUPPLY
        bool "LDR between 3.3 V and the GPIO (fixed resistor to GND)"
        default y
        help
            With this wiring the voltage rises with light. Disable it if the LDR goes from the
            GPIO to GND (fixed resistor to 3.3 V).

    config LDR_FIXED_RESISTOR_OHMS
        int "Fixed resistor of the divider (ohms)"
        range 100 1000000
        default 10000

    config LDR_RESISTANCE_AT_10_LUX_OHMS
        int "LDR resistance at 10 lux (ohms, datasheet)"
        range 100 1000000
        default 10000
        help
            GL55xx parts: about 8-20 kOhm at 10 lux.

    config LDR_GAMMA_X100
        int "LDR gamma x 100 (datasheet)"
        range 10 200
        default 70
        help
            Slope of log(R) against log(lux); GL55xx parts: 0.6-0.8.

endmenu
```

## test/data_repository/sdkconfig.defaults
```kconfig
CONFIG_DEVICE_ID="test-device"
CONFIG_FIREBASE_DB_URL="https://test-db.example.com"
CONFIG_UNITY_ENABLE_64BIT=y
```

## test/firebase_auth/sdkconfig.defaults
```kconfig
CONFIG_FIREBASE_API_KEY="test-api-key"
CONFIG_FIREBASE_USER_EMAIL="device@test.com"
CONFIG_FIREBASE_USER_PASSWORD="secret"
```

## test/firebase_rtdb/sdkconfig.defaults
```kconfig
CONFIG_FIREBASE_DB_URL="https://test-db.example.com"
CONFIG_FIREBASE_API_KEY="test-api-key"
CONFIG_FIREBASE_USER_EMAIL="device@test.com"
CONFIG_FIREBASE_USER_PASSWORD="secret"
```
